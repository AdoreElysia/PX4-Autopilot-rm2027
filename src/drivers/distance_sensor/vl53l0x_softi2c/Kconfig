## src/drivers/distance_sensor/vl53l0x_softi2c/Kconfig
```kconfig
menuconfig DRIVERS_DISTANCE_SENSOR_VL53L0X_SOFTI2C
	bool "vl53l0x_softi2c"
	default n
	---help---
		Enable support for a VL53L0X time-of-flight distance sensor connected
		over a software (bit-banged) I2C bus built from two plain GPIOs.

		Needed on boards that do not route a usable hardware I2C bus to a
		connector (e.g. rm2027/fmu-h743). The board must define
		BOARD_VL53L0X_SOFTI2C_SCL_PINSET and BOARD_VL53L0X_SOFTI2C_SDA_PINSET
		in its board_config.h; the pins are usually TEMPORARY.
```

## src/drivers/imu/hipnuc_h104/Kconfig
```kconfig
menuconfig DRIVERS_IMU_HIPNUC_H104
	bool "hipnuc h104 (serial IMU)"
	default n
	---help---
		Enable support for the HiPNUC H104 (HI04M0) external IMU on a serial port.
		Parses HiPNUC HI91 frames (82 bytes, CRC-16/XMODEM) and publishes
		sensor_gyro + sensor_accel with a shared device_id.
```

## src/drivers/imu/hxy/hxy42688p/Kconfig
```kconfig
menuconfig DRIVERS_IMU_HXY_HXY42688P
	bool "huaxuanyang hxy42688p"
	default n
	---help---
		Enable support for the 华轩阳 (HuaXuanYang / HXY) "ICM-42688P"
		six-axis IMU module (SPI, WHO_AM_I(0x01) = 0x6A).

		This is an independent driver implemented strictly from the vendor
		manual (华轩阳HXY_ICM-42688P_六轴传感器模块_手册), NOT the Bosch
		BMI270 driver and NOT a Bosch-compatible patch.
```

## src/modules/gyrofft_bridge/Kconfig
```kconfig
menuconfig MODULES_GYROFFT_BRIDGE
	bool "gyrofft_bridge"
	default n
	---help---
		Bridge the onboard gyro FFT peaks (sensor_gyro_fft) plus the
		current motor thrust into debug_array, so they can be streamed
		over MAVLink DEBUG_FLOAT_ARRAY.
```

## src/modules/rc_throttle/Kconfig
```kconfig
menuconfig MODULES_RC_THROTTLE
	bool "rc_throttle"
	default n
	---help---
		RM2027 RC link self-check: print input_rc raw pulse widths and
		manual_control_setpoint (mapped stick values) so that the RC link
		and the throttle channel can be verified on the bench.
		Monitor only - does not drive any actuator.
```

## src/systemcmds/h104cap/Kconfig
```kconfig
menuconfig SYSTEMCMDS_H104CAP
	bool "h104cap"
	default n
	---help---
		Enable support for h104cap — H104 (HiPNUC) 外置陀螺串口帧抓取 / 协议探测工具。
		一次性诊断用：把 USART1 收到的原始字节存进固定 RAM 缓冲，便于 SWD dump。

		符号全名（写进 board 的 default.px4board）：
		  CONFIG_SYSTEMCMDS_H104CAP=y
```
